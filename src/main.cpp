
#include <Arduino.h>
#include <esp_display_panel.hpp>
#include <lvgl.h>
#include "lvgl_v8_port.h"

#include "ui.h"
#include "screens.h"
#include "ecu_data.h"
#include "waveshare_twai_port.h"

#include <driver/twai.h>
#include <esp_now.h>
#include <esp_wifi.h>
#include <WiFi.h>
#include <string.h>
#include <math.h>

using namespace esp_panel::drivers;
using namespace esp_panel::board;

// ============================================================
// WAVESHARE ESP32-S3 - TRIJEKT PREMIUM 3.0
// RWB DASHBOARD
//
// MODE 1: Original RPM / BATT / LAMBDA / TEMP
// MODE 2: All 20 Trijekt CAN values
//
// MODE 2:
// - Custom ui_font_Hollow22
// - Individual X/Y positions
// - Individual enable/disable
//
// NO SIMULATION
// ESP-NOW ENABLED
// ============================================================

// Custom font generated by EEZ Studio
LV_FONT_DECLARE(ui_font_Hollow38);

// Required by existing generated screens.c
extern "C" {
    bool TEST_MODE = false;
}

// ============================================================
// SETTINGS
// ============================================================

static constexpr uint32_t CAN_A = 700;
static constexpr uint32_t CAN_B = 710;
// Trijekt Premium CAN base IDs (hexadecimal)
//static constexpr uint32_t CAN_A = 0x700;
//static constexpr uint32_t CAN_B = 0x710;



static constexpr uint32_t RPM_TIMEOUT_MS = 2000;
static constexpr uint32_t SENSOR_TIMEOUT_MS = 5000;

static constexpr uint32_t UI_INTERVAL_MS = 30;
static constexpr uint32_t ESPNOW_INTERVAL_MS = 50;
static constexpr uint32_t DEBUG_INTERVAL_MS = 1000;
static constexpr uint32_t CAN_DEBUG_INTERVAL_MS = 5000;

static constexpr uint16_t MAX_RPM = 8000;
static constexpr int CAN_BATCH_SIZE = 512;
static constexpr int CAN_VALUE_COUNT = 20;

// ============================================================
// GLOBAL ECU DATA
// ============================================================

ECUData ecu;

Board *board = nullptr;

bool can_ok = false;

uint32_t lastRpmUpdateMs = 0;
uint32_t lastCanUpdateMs = 0;

uint16_t rpm_max = 0;

// ============================================================
// TRIJEKT VALUES
// ============================================================

struct TrijektValues {

    uint16_t rpm = 0;
    uint16_t torque = 0;
    uint16_t motorStatus = 0;

    float fuelConsumption = 0.0f;

    float throttleDK = 0.0f;
    float throttlePedal = 0.0f;

    uint16_t egasControl = 0;
    float egasTarget = 0.0f;

    float engineTemp = 0.0f;
    float airTemp = 0.0f;
    float internalTemp = 0.0f;
    float oilTemp = 0.0f;

    uint16_t intakePressure = 0;
    uint16_t externalPressure = 0;
    uint16_t fuelPressure = 0;
    uint16_t oilPressure = 0;

    float lambda1 = 0.0f;
    float lambda2 = 0.0f;

    float battery = 0.0f;

    bool rpmValid = false;
    bool throttleValid = false;
    bool tempValid = false;
    bool oilTempValid = false;
    bool pressureValid = false;
    bool lambda1Valid = false;
    bool lambda2Valid = false;
    bool batteryValid = false;

    uint32_t lastRpmMs = 0;
    uint32_t lastThrottleMs = 0;
    uint32_t lastTempMs = 0;
    uint32_t lastOilMs = 0;
    uint32_t lastPressureMs = 0;
    uint32_t lastLambdaMs = 0;
    uint32_t lastBatteryMs = 0;
};

TrijektValues trijekt;
// =====================================================
// MODE 1 - AIR TEMP AND FUEL FROM TRIJEKT CAN
// =====================================================

extern "C" float mode1_air_temp_c(void)
{
    return trijekt.airTemp;
}

extern "C" float mode1_fuel_consumption_lph(void)
{
    return trijekt.fuelConsumption;
}


// ============================================================
// MODE 2 - VALUE IDENTIFIERS
// ============================================================

enum Mode2ValueID {

    M2_RPM = 0,
    M2_TORQUE,
    M2_STATUS,
    M2_FUEL,
    M2_THROTTLE,
    M2_PEDAL,
    M2_EGAS,
    M2_ETARGET,
    M2_ENGINE_TEMP,
    M2_AIR_TEMP,
    M2_ECU_TEMP,
    M2_OIL_TEMP,
    M2_INTAKE,
    M2_EXTERNAL,
    M2_FUEL_PRESSURE,
    M2_OIL_PRESSURE,
    M2_LAMBDA1,
    M2_LAMBDA2,
    M2_BATTERY,
    M2_MAX_RPM
};

// ============================================================
// MODE 2 - CONFIGURE ALL VALUES HERE
// ============================================================
//
// FORMAT:
//
// { ENABLED, X, Y, "DISPLAY NAME" }
//
// true  = show value
// false = hide value
//
// X = horizontal position from left
// Y = vertical position from top
//
// Every value uses ui_font_Hollow22.
//
// ============================================================

struct Mode2Layout {
    bool enabled;
    int16_t x;
    int16_t y;
    const char *name;
};

static Mode2Layout mode2Layout[CAN_VALUE_COUNT] = {

    // ========================================================
    // LEFT COLUMN
    // ========================================================

    { true,   20,  65, "RPM"         },
    { true,   20, 100, "Torque"      },
    { true,   20, 135, "Status"      },
    { true,   20, 170, "Fuel"        },
    { true,   20, 205, "Throttle"    },
    { true,   20, 240, "Pedal"       },
    { true,   20, 275, "E-Gas"       },
    { true,   20, 310, "E-Target"    },
    { true,   20, 345, "Engine Temp" },
    { true,   20, 380, "Air Temp"    },

    // ========================================================
    // RIGHT COLUMN
    // ========================================================

    { true,  410,  65, "ECU Temp"    },
    { true,  410, 100, "Oil Temp"    },
    { true,  410, 135, "Intake"      },
    { true,  410, 170, "External"    },
    { true,  410, 205, "Fuel Press"  },
    { true,  410, 240, "Oil Press"   },
    { true,  410, 275, "Lambda 1"    },
    { true,  410, 310, "Lambda 2"    },
    { true,  410, 345, "Battery"     },
    { true,  410, 380, "Max RPM"     }
};

// ============================================================
// CAN DIAGNOSTICS
// ============================================================

struct CANIDStats {

    uint32_t count = 0;
    uint32_t lastMs = 0;

    uint8_t lastData[8] = {0};
    uint8_t dlc = 0;
};

static CANIDStats canStats[2048];

static uint32_t totalCANFrames = 0;
static uint32_t lastCANCount = 0;

static uint32_t extendedFrames = 0;
static uint32_t remoteFrames = 0;

static uint32_t canLastReportMs = 0;

// ============================================================
// RECORD CAN FRAME
// ============================================================

static void recordCANFrame(const twai_message_t &m)
{
    totalCANFrames++;

    if (m.extd) {
        extendedFrames++;
        return;
    }

    if (m.rtr) {
        remoteFrames++;
        return;
    }

    if (m.identifier >= 2048)
        return;

    CANIDStats &s = canStats[m.identifier];

    s.count++;
    s.lastMs = millis();
    s.dlc = m.data_length_code;

    memset(s.lastData, 0, sizeof(s.lastData));

    uint8_t len = m.data_length_code;

    if (len > 8)
        len = 8;

    memcpy(s.lastData, m.data, len);
}

// ============================================================
// PRINT CAN DIAGNOSTICS
// ============================================================

static void printCANDiagnostics()
{
    uint32_t now = millis();
    uint32_t elapsed = now - canLastReportMs;

    uint32_t newFrames =
        totalCANFrames - lastCANCount;

    float rate = 0.0f;

    if (elapsed > 0) {
        rate = newFrames * 1000.0f / elapsed;
    }

    Serial.println();
    Serial.println("====================================");
    Serial.println("CAN DIAGNOSTICS");
    Serial.println("====================================");

    Serial.printf(
        "Total frames: %lu\n",
        (unsigned long)totalCANFrames
    );

    Serial.printf(
        "Frame rate: %.1f/s\n",
        rate
    );

    Serial.printf(
        "Extended: %lu\n",
        (unsigned long)extendedFrames
    );

    Serial.printf(
        "Remote: %lu\n",
        (unsigned long)remoteFrames
    );

    Serial.println("ID  COUNT  AGE(ms)  DATA");

    for (int id = 0; id < 2048; id++) {

        const CANIDStats &s = canStats[id];

        if (s.count == 0)
            continue;

        Serial.printf(
            "%d  %lu  %lu  ",
            id,
            (unsigned long)s.count,
            (unsigned long)(now - s.lastMs)
        );

        for (int i = 0; i < s.dlc && i < 8; i++) {
            Serial.printf("%02X ", s.lastData[i]);
        }

        Serial.println();
    }

    twai_status_info_t status{};

    if (twai_get_status_info(&status) == ESP_OK) {

        Serial.printf(
            "RX queue: %lu\n",
            (unsigned long)status.msgs_to_rx
        );

        Serial.printf(
            "RX missed: %lu\n",
            (unsigned long)status.rx_missed_count
        );

        Serial.printf(
            "RX overrun: %lu\n",
            (unsigned long)status.rx_overrun_count
        );

        Serial.printf(
            "Bus errors: %lu\n",
            (unsigned long)status.bus_error_count
        );

        Serial.printf(
            "TX failed: %lu\n",
            (unsigned long)status.tx_failed_count
        );
    }

    Serial.println("====================================");

    lastCANCount = totalCANFrames;
    canLastReportMs = millis();
}

// ============================================================
// ESP-NOW
// ============================================================

static uint8_t espnow_broadcast_addr[] = {
    0xFF, 0xFF, 0xFF,
    0xFF, 0xFF, 0xFF
};

static bool espnow_ready = false;
static bool espnow_enabled = true;

static uint32_t lastEspNowSendMs = 0;

static const uint8_t ESPNOW_WIFI_CHANNEL = 1;

// Original packet format for M5Stack
struct DashPacket {

    uint16_t rpm;

    float batt;
    float motor;
    float dk;
    float gp;

    uint8_t funk;

} __attribute__((packed));

void setEspNowEnabled(bool enabled)
{
    espnow_enabled = enabled;
}

// ============================================================
// ESP-NOW INITIALIZATION
// ============================================================

static bool espnow_init_simple()
{
    WiFi.mode(WIFI_STA);
    WiFi.disconnect();

    esp_err_t channelErr = esp_wifi_set_channel(
        ESPNOW_WIFI_CHANNEL,
        WIFI_SECOND_CHAN_NONE
    );

    if (channelErr != ESP_OK) {

        Serial.printf(
            "ESP-NOW CHANNEL ERROR: %d\n",
            (int)channelErr
        );

        return false;
    }

    esp_err_t err = esp_now_init();

    if (
        err != ESP_OK &&
        err != ESP_ERR_ESPNOW_EXIST
    ) {
        Serial.println("ESP-NOW INIT FAILED");
        return false;
    }

    esp_now_peer_info_t peer{};

    memcpy(
        peer.peer_addr,
        espnow_broadcast_addr,
        6
    );

    peer.channel = ESPNOW_WIFI_CHANNEL;
    peer.encrypt = false;

    if (!esp_now_is_peer_exist(espnow_broadcast_addr)) {

        err = esp_now_add_peer(&peer);

        if (err != ESP_OK) {

            Serial.printf(
                "ESP-NOW PEER ERROR: %d\n",
                (int)err
            );

            return false;
        }
    }

    espnow_ready = true;

    Serial.println("ESP-NOW READY");
    Serial.println(WiFi.macAddress());

    return true;
}

// ============================================================
// CAN DECODING HELPERS
// ============================================================

static inline uint16_t U16LE(const uint8_t *d)
{
    return uint16_t(d[0]) |
           (uint16_t(d[1]) << 8);
}

static inline int16_t S16LE(const uint8_t *d)
{
    return (int16_t)U16LE(d);
}

static bool validRPM(uint16_t value)
{
    return value <= MAX_RPM;
}

static bool validTemp(float value)
{
    return value >= -40.0f &&
           value <= 180.0f;
}

static bool validBattery(float value)
{
    return value >= 8.0f &&
           value <= 18.0f;
}

static bool validLambda(float value)
{
    return value >= 0.65f &&
           value <= 2.5f;
}

static bool fresh(
    bool valid,
    uint32_t lastMs,
    uint32_t timeoutMs = SENSOR_TIMEOUT_MS
)
{
    return valid &&
           (millis() - lastMs <= timeoutMs);
}

// ============================================================
// TRIJEKT CAN DECODER
// ============================================================

void decodeCANMessage(const twai_message_t &m)
{
    if (m.extd || m.rtr)
        return;

    if (m.data_length_code != 8)
        return;

    uint32_t now = millis();

    const uint8_t *d = m.data;

    bool decoded = false;

    switch (m.identifier)
    {
        // CAN 700 - RPM / TORQUE / STATUS / FUEL

        case CAN_A + 0:
        {
            uint16_t rpm = U16LE(d);

            if (!validRPM(rpm))
                break;

            trijekt.rpm = rpm;
            trijekt.torque = U16LE(d + 2);
            trijekt.motorStatus = U16LE(d + 4);

            trijekt.fuelConsumption =
                U16LE(d + 6) * 0.1f;

            trijekt.rpmValid = true;
            trijekt.lastRpmMs = now;

            ecu.rpm = rpm;
            lastRpmUpdateMs = now;

            if (rpm > rpm_max)
                rpm_max = rpm;

            decoded = true;
            break;
        }

        // CAN 701 - THROTTLE / PEDAL / E-GAS

        case CAN_A + 1:
        {
            trijekt.throttleDK =
                U16LE(d) * 0.1f;

            trijekt.throttlePedal =
                U16LE(d + 2) * 0.1f;

            trijekt.egasControl =
                U16LE(d + 4);

            trijekt.egasTarget =
                U16LE(d + 6) * 0.1f;

            trijekt.throttleValid = true;
            trijekt.lastThrottleMs = now;

            ecu.throttle_dk = trijekt.throttleDK;
            ecu.throttle_pedal = trijekt.throttlePedal;

            decoded = true;
            break;
        }

        // CAN 702 - ENGINE / AIR / ECU TEMP

        case CAN_A + 2:
        {
            float engineTemp =
                S16LE(d) * 0.1f;

            float airTemp =
                S16LE(d + 2) * 0.1f;

            float internalTemp =
                S16LE(d + 6) * 0.1f;

            if (!validTemp(engineTemp))
                break;

            trijekt.engineTemp = engineTemp;
            trijekt.airTemp = airTemp;
            trijekt.internalTemp = internalTemp;

            trijekt.tempValid = true;
            trijekt.lastTempMs = now;

            ecu.motor = engineTemp;

            decoded = true;
            break;
        }

        // CAN 703 - OIL TEMPERATURE

        case CAN_A + 3:
        {
            float oilTemp =
                S16LE(d) * 0.1f;

            if (!validTemp(oilTemp))
                break;

            trijekt.oilTemp = oilTemp;

            trijekt.oilTempValid = true;
            trijekt.lastOilMs = now;

            decoded = true;
            break;
        }

        // CAN 704 - PRESSURES

        case CAN_A + 4:
        {
            trijekt.intakePressure =
                U16LE(d);

            trijekt.externalPressure =
                U16LE(d + 2);

            trijekt.fuelPressure =
                U16LE(d + 4);

            trijekt.oilPressure =
                U16LE(d + 6);

            trijekt.pressureValid = true;
            trijekt.lastPressureMs = now;

            decoded = true;
            break;
        }

        // CAN 705 - LAMBDA

        case CAN_A + 5:
        {
            float lambda1 =
                U16LE(d) * 0.001f;

            float lambda2 =
                U16LE(d + 2) * 0.001f;

            trijekt.lambda1 = lambda1;
            trijekt.lambda2 = lambda2;

            trijekt.lambda1Valid =
                validLambda(lambda1);

            trijekt.lambda2Valid =
                validLambda(lambda2);

            trijekt.lastLambdaMs = now;

            if (trijekt.lambda1Valid)
                ecu.lambda = lambda1;

            decoded = true;
            break;
        }

        // CAN 711 - BATTERY

        case CAN_B + 1:
        {
            float battery =
                U16LE(d + 2) * 0.001f;

            if (!validBattery(battery))
                break;

            trijekt.battery = battery;

            trijekt.batteryValid = true;
            trijekt.lastBatteryMs = now;

            ecu.batt = battery;

            decoded = true;
            break;
        }

        default:
            break;
    }

    if (decoded) {
        lastCanUpdateMs = now;
        ecu.last_update = now;
    }
}

// ============================================================
// ECU HOUSEKEEPING
// ============================================================

void updateECUHousekeeping()
{
    bool rpmFresh = fresh(
        trijekt.rpmValid,
        trijekt.lastRpmMs,
        RPM_TIMEOUT_MS
    );

    bool lambdaFresh = fresh(
        trijekt.lambda1Valid,
        trijekt.lastLambdaMs
    );

    ecu.data_valid = rpmFresh ? 1 : 0;
    ecu.lambda_valid = lambdaFresh ? 1 : 0;

    ecu.engine_running =
        rpmFresh && ecu.rpm > 100;

    if (!rpmFresh)
        ecu.rpm = 0;
}

// ============================================================
// ORIGINAL MODE 1 DASHBOARD FUNCTIONS
// ============================================================

extern "C" void update_mock_rpm();
extern "C" void update_mock_throttle();
extern "C" void update_mock_lambda();
extern "C" void update_mock_motor_temp();

// ============================================================
// SERIAL HELPERS
// ============================================================

static void printFloatValue(
    const char *label,
    float value,
    const char *unit,
    bool valid,
    uint32_t lastMs,
    uint8_t decimals = 1,
    uint32_t timeoutMs = SENSOR_TIMEOUT_MS
)
{
    Serial.printf("%-19s : ", label);

    if (fresh(valid, lastMs, timeoutMs)) {

        Serial.print(value, decimals);

        if (unit && unit[0]) {
            Serial.print(" ");
            Serial.print(unit);
        }

        Serial.println();
    }
    else {
        Serial.println("--");
    }
}

static void printIntValue(
    const char *label,
    uint32_t value,
    const char *unit,
    bool valid,
    uint32_t lastMs,
    uint32_t timeoutMs = SENSOR_TIMEOUT_MS
)
{
    Serial.printf("%-19s : ", label);

    if (fresh(valid, lastMs, timeoutMs)) {

        Serial.print(value);

        if (unit && unit[0]) {
            Serial.print(" ");
            Serial.print(unit);
        }

        Serial.println();
    }
    else {
        Serial.println("--");
    }
}

// ============================================================
// PRINT ALL TRIJEKT VALUES
// ============================================================

void printAllValues()
{
    Serial.println();
    Serial.println("====================================");
    Serial.println("TRIJEKT LIVE VALUES");
    Serial.println("====================================");

    printIntValue(
        "RPM", trijekt.rpm, "rpm",
        trijekt.rpmValid, trijekt.lastRpmMs,
        RPM_TIMEOUT_MS
    );

    printIntValue(
        "Torque", trijekt.torque, "Nm",
        trijekt.rpmValid, trijekt.lastRpmMs,
        RPM_TIMEOUT_MS
    );

    printIntValue(
        "Motor status", trijekt.motorStatus, "",
        trijekt.rpmValid, trijekt.lastRpmMs,
        RPM_TIMEOUT_MS
    );

    printFloatValue(
        "Fuel", trijekt.fuelConsumption, "L/h",
        trijekt.rpmValid, trijekt.lastRpmMs,
        1, RPM_TIMEOUT_MS
    );

    printFloatValue(
        "Throttle DK", trijekt.throttleDK, "%",
        trijekt.throttleValid, trijekt.lastThrottleMs
    );

    printFloatValue(
        "Pedal", trijekt.throttlePedal, "%",
        trijekt.throttleValid, trijekt.lastThrottleMs
    );

    printIntValue(
        "E-Gas", trijekt.egasControl, "",
        trijekt.throttleValid, trijekt.lastThrottleMs
    );

    printFloatValue(
        "E-Target", trijekt.egasTarget, "deg",
        trijekt.throttleValid, trijekt.lastThrottleMs
    );

    printFloatValue(
        "Engine Temp", trijekt.engineTemp, "C",
        trijekt.tempValid, trijekt.lastTempMs
    );

    printFloatValue(
        "Air Temp", trijekt.airTemp, "C",
        trijekt.tempValid, trijekt.lastTempMs
    );

    printFloatValue(
        "ECU Temp", trijekt.internalTemp, "C",
        trijekt.tempValid, trijekt.lastTempMs
    );

    printFloatValue(
        "Oil Temp", trijekt.oilTemp, "C",
        trijekt.oilTempValid, trijekt.lastOilMs
    );

    printIntValue(
        "Intake", trijekt.intakePressure, "hPa",
        trijekt.pressureValid, trijekt.lastPressureMs
    );

    printIntValue(
        "External", trijekt.externalPressure, "hPa",
        trijekt.pressureValid, trijekt.lastPressureMs
    );

    printIntValue(
        "Fuel Press", trijekt.fuelPressure, "kPa",
        trijekt.pressureValid, trijekt.lastPressureMs
    );

    printIntValue(
        "Oil Press", trijekt.oilPressure, "kPa",
        trijekt.pressureValid, trijekt.lastPressureMs
    );

    printFloatValue(
        "Lambda 1", trijekt.lambda1, "",
        trijekt.lambda1Valid, trijekt.lastLambdaMs, 3
    );

    printFloatValue(
        "Lambda 2", trijekt.lambda2, "",
        trijekt.lambda2Valid, trijekt.lastLambdaMs, 3
    );

    printFloatValue(
        "Battery", trijekt.battery, "V",
        trijekt.batteryValid, trijekt.lastBatteryMs, 2
    );

    Serial.printf(
        "Max RPM: %u\n",
        rpm_max
    );

    Serial.printf(
        "CAN: %s\n",
        can_ok ? "READY" : "ERROR"
    );

    Serial.printf(
        "ESP-NOW: %s\n",
        espnow_ready ? "READY" : "ERROR"
    );

    Serial.println("====================================");
}

// ============================================================
// ESP-NOW SEND
// ============================================================

void sendEspNowValues()
{
    if (!espnow_ready || !espnow_enabled)
        return;

    uint32_t now = millis();

    if (now - lastEspNowSendMs < ESPNOW_INTERVAL_MS)
        return;

    DashPacket pkt{};

    pkt.rpm = ecu.data_valid ? ecu.rpm : 0;

    pkt.batt = fresh(
        trijekt.batteryValid,
        trijekt.lastBatteryMs
    ) ? ecu.batt : 0.0f;

    pkt.motor = fresh(
        trijekt.tempValid,
        trijekt.lastTempMs
    ) ? ecu.motor : 0.0f;

    pkt.dk = fresh(
        trijekt.throttleValid,
        trijekt.lastThrottleMs
    ) ? ecu.throttle_dk : 0.0f;

    pkt.gp = fresh(
        trijekt.throttleValid,
        trijekt.lastThrottleMs
    ) ? ecu.throttle_pedal : 0.0f;

    pkt.funk = 0;

    esp_err_t err = esp_now_send(
        espnow_broadcast_addr,
        reinterpret_cast<const uint8_t*>(&pkt),
        sizeof(pkt)
    );

    if (err != ESP_OK) {

        static uint32_t lastErrorMs = 0;

        if (now - lastErrorMs >= 5000) {

            Serial.printf(
                "ESP-NOW SEND ERROR: %d\n",
                (int)err
            );

            lastErrorMs = now;
        }
    }

    lastEspNowSendMs = now;
}

// ============================================================
// MODE 1 / MODE 2 SCREENS
// ============================================================

static lv_obj_t *originalScreen = nullptr;
static lv_obj_t *canScreen = nullptr;

static lv_obj_t *canValueLabels[CAN_VALUE_COUNT] = {};

static uint32_t lastCANScreenUpdate = 0;

// ============================================================
// SCREEN SWITCHING
// ============================================================

// Call these from LVGL event callbacks.
// LVGL must already be locked or running its event handler.

extern "C" void open_trijekt_mode2(void)
{
    if (canScreen) {
        lv_scr_load(canScreen);
    }
}

extern "C" void open_trijekt_mode1(void)
{
    if (originalScreen) {
        lv_scr_load(originalScreen);
    }
}

// ============================================================
// MODE 2 BUTTON EVENT
// ============================================================

static void mode2_button_event(lv_event_t *event)
{
    if (lv_event_get_code(event) == LV_EVENT_CLICKED) {
        open_trijekt_mode2();
    }
}

// ============================================================
// MODE 1 RETURN BUTTON EVENT
// ============================================================

static void mode1_button_event(lv_event_t *event)
{
    if (lv_event_get_code(event) == LV_EVENT_CLICKED) {
        open_trijekt_mode1();
    }
}

// ============================================================
// FIND EXISTING MODE 2 BUTTON
// ============================================================
//
// Searches for an LVGL label containing "MODE 2".
// Attaches an additional click callback to its parent.
//
// If your generated UI uses a different label or
// its existing callback changes screens afterward,
// connect open_trijekt_mode2() directly in screens.c.
//
// ============================================================

static bool findAndAttachMode2(lv_obj_t *parent)
{
    if (!parent)
        return false;

    uint32_t count = lv_obj_get_child_cnt(parent);

    for (uint32_t i = 0; i < count; i++) {

        lv_obj_t *child =
            lv_obj_get_child(parent, i);

        if (!child)
            continue;

        if (lv_obj_check_type(child, &lv_label_class)) {

            const char *label =
                lv_label_get_text(child);

            if (label) {

                String text = String(label);
                text.toLowerCase();

                if (
                    text.indexOf("mode 2") >= 0 ||
                    text.indexOf("mode2") >= 0
                ) {
                    lv_obj_t *button =
                        lv_obj_get_parent(child);

                    if (button) {

                        lv_obj_add_flag(
                            button,
                            LV_OBJ_FLAG_CLICKABLE
                        );

                        lv_obj_add_event_cb(
                            button,
                            mode2_button_event,
                            LV_EVENT_CLICKED,
                            nullptr
                        );

                        Serial.println(
                            "MODE 2 BUTTON CONNECTED"
                        );

                        return true;
                    }
                }
            }
        }

        if (findAndAttachMode2(child))
            return true;
    }

    return false;
}

// ============================================================
// CREATE MODE 2 FULLSCREEN
// ============================================================

static void createCANScreen()
{
    if (canScreen)
        return;

    canScreen = lv_obj_create(nullptr);

    lv_obj_clear_flag(
        canScreen,
        LV_OBJ_FLAG_SCROLLABLE
    );

    lv_obj_set_style_bg_color(
        canScreen,
        lv_color_hex(0x000000),
        LV_PART_MAIN
    );

    lv_obj_set_style_bg_opa(
        canScreen,
        LV_OPA_COVER,
        LV_PART_MAIN
    );

    lv_obj_set_style_border_width(
        canScreen,
        0,
        LV_PART_MAIN
    );

    // ========================================================
    // TITLE - HOLLOW22
    // ========================================================

    lv_obj_t *title = lv_label_create(canScreen);

    lv_label_set_text(
        title,
        "TRIJEKT PREMIUM RWB J"
    );

    lv_obj_set_style_text_font(
        title,
        &ui_font_Hollow38,
        LV_PART_MAIN
    );

    lv_obj_set_style_text_color(
        title,
        lv_color_hex(0xFFFFFF),
        LV_PART_MAIN
    );

    lv_obj_align(
        title,
        LV_ALIGN_TOP_MID,
        0,
        8
    );

    // ========================================================
    // CREATE ALL 20 MODE 2 VALUES
    // ========================================================

    for (int i = 0; i < CAN_VALUE_COUNT; i++) {

        // Do not create disabled values.
        if (!mode2Layout[i].enabled) {
            canValueLabels[i] = nullptr;
            continue;
        }

        lv_obj_t *label =
            lv_label_create(canScreen);

        canValueLabels[i] = label;

        // ----------------------------------------------------
        // HOLLOW22 FONT FOR EVERY MODE 2 VALUE
        // ----------------------------------------------------

        lv_obj_set_style_text_font(
            label,
            &ui_font_Hollow38,
            LV_PART_MAIN
        );

        // ----------------------------------------------------
        // WHITE TEXT
        // ----------------------------------------------------

        lv_obj_set_style_text_color(
            label,
            lv_color_hex(0xFFFFFF),
            LV_PART_MAIN
        );

        // ----------------------------------------------------
        // TRANSPARENT BACKGROUND
        // ----------------------------------------------------

        lv_obj_set_style_bg_opa(
            label,
            LV_OPA_TRANSP,
            LV_PART_MAIN
        );

        // ----------------------------------------------------
        // INDIVIDUAL X/Y POSITION
        // ----------------------------------------------------

        lv_obj_set_pos(
            label,
            mode2Layout[i].x,
            mode2Layout[i].y
        );

        // ----------------------------------------------------
        // INITIAL TEXT
        // ----------------------------------------------------

        lv_label_set_text_fmt(
            label,
            "%s: ---",
            mode2Layout[i].name
        );
    }

    // ========================================================
    // MODE 1 RETURN BUTTON
    // ========================================================

    lv_obj_t *backButton =
        lv_btn_create(canScreen);

    lv_obj_set_size(
        backButton,
        130,
        38
    );

    lv_obj_align(
        backButton,
        LV_ALIGN_BOTTOM_LEFT,
        12,
        -6
    );

    lv_obj_set_style_bg_color(
        backButton,
        lv_color_hex(0x333333),
        LV_PART_MAIN
    );

    lv_obj_set_style_border_color(
        backButton,
        lv_color_white(),
        LV_PART_MAIN
    );

    lv_obj_set_style_border_width(
        backButton,
        1,
        LV_PART_MAIN
    );

    lv_obj_t *backLabel =
        lv_label_create(backButton);

    lv_label_set_text(
        backLabel,
        "MODE 1"
    );

    lv_obj_set_style_text_font(
        backLabel,
        &ui_font_Hollow38,
        LV_PART_MAIN
    );

    lv_obj_set_style_text_color(
        backLabel,
        lv_color_white(),
        LV_PART_MAIN
    );

    lv_obj_center(backLabel);

    lv_obj_add_event_cb(
        backButton,
        mode1_button_event,
        LV_EVENT_CLICKED,
        nullptr
    );

    Serial.println(
        "MODE 2 HOLLOW22 SCREEN CREATED"
    );
}

// ============================================================
// UPDATE MODE 2 VALUES
// ============================================================

static void updateCANScreen()
{
    if (!canScreen)
        return;

    if (lv_scr_act() != canScreen)
        return;

    uint32_t now = millis();

    if (now - lastCANScreenUpdate < 200)
        return;

    lastCANScreenUpdate = now;

    bool rpmOK = fresh(
        trijekt.rpmValid,
        trijekt.lastRpmMs,
        RPM_TIMEOUT_MS
    );

    bool throttleOK = fresh(
        trijekt.throttleValid,
        trijekt.lastThrottleMs
    );

    bool tempOK = fresh(
        trijekt.tempValid,
        trijekt.lastTempMs
    );

    bool oilOK = fresh(
        trijekt.oilTempValid,
        trijekt.lastOilMs
    );

    bool pressureOK = fresh(
        trijekt.pressureValid,
        trijekt.lastPressureMs
    );

    bool lambda1OK = fresh(
        trijekt.lambda1Valid,
        trijekt.lastLambdaMs
    );

    bool lambda2OK = fresh(
        trijekt.lambda2Valid,
        trijekt.lastLambdaMs
    );

    bool batteryOK = fresh(
        trijekt.batteryValid,
        trijekt.lastBatteryMs
    );

    // ========================================================
    // UPDATE EVERY ENABLED LABEL
    // ========================================================

    for (int i = 0; i < CAN_VALUE_COUNT; i++) {

        if (!mode2Layout[i].enabled)
            continue;

        lv_obj_t *label = canValueLabels[i];

        if (!label)
            continue;

        bool valid = false;

        float floatValue = 0.0f;
        uint32_t intValue = 0;

        bool isFloat = false;
        int decimals = 1;

        const char *unit = "";

        switch (i)
        {
            // ------------------------------------------------
            // RPM
            // ------------------------------------------------

            case M2_RPM:
                valid = rpmOK;
                intValue = trijekt.rpm;
                break;

            // ------------------------------------------------
            // TORQUE
            // ------------------------------------------------

            case M2_TORQUE:
                valid = rpmOK;
                intValue = trijekt.torque;
                unit = " Nm";
                break;

            // ------------------------------------------------
            // MOTOR STATUS
            // ------------------------------------------------

            case M2_STATUS:
                valid = rpmOK;
                intValue = trijekt.motorStatus;
                break;

            // ------------------------------------------------
            // FUEL CONSUMPTION
            // ------------------------------------------------

            case M2_FUEL:
                valid = rpmOK;
                floatValue = trijekt.fuelConsumption;
                isFloat = true;
                unit = " L/h";
                break;

            // ------------------------------------------------
            // THROTTLE
            // ------------------------------------------------

            case M2_THROTTLE:
                valid = throttleOK;
                floatValue = trijekt.throttleDK;
                isFloat = true;
                unit = "%";
                break;

            // ------------------------------------------------
            // PEDAL
            // ------------------------------------------------

            case M2_PEDAL:
                valid = throttleOK;
                floatValue = trijekt.throttlePedal;
                isFloat = true;
                unit = "%";
                break;

            // ------------------------------------------------
            // E-GAS
            // ------------------------------------------------

            case M2_EGAS:
                valid = throttleOK;
                intValue = trijekt.egasControl;
                break;

            // ------------------------------------------------
            // E-GAS TARGET
            // ------------------------------------------------

            case M2_ETARGET:
                valid = throttleOK;
                floatValue = trijekt.egasTarget;
                isFloat = true;
                unit = " deg";
                break;

            // ------------------------------------------------
            // ENGINE TEMP
            // ------------------------------------------------

            case M2_ENGINE_TEMP:
                valid = tempOK;
                floatValue = trijekt.engineTemp;
                isFloat = true;
                unit = " C";
                break;

            // ------------------------------------------------
            // AIR TEMP
            // ------------------------------------------------

            case M2_AIR_TEMP:
                valid = tempOK;
                floatValue = trijekt.airTemp;
                isFloat = true;
                unit = " C";
                break;

            // ------------------------------------------------
            // ECU INTERNAL TEMP
            // ------------------------------------------------

            case M2_ECU_TEMP:
                valid = tempOK;
                floatValue = trijekt.internalTemp;
                isFloat = true;
                unit = " C";
                break;

            // ------------------------------------------------
            // OIL TEMP
            // ------------------------------------------------

            case M2_OIL_TEMP:
                valid = oilOK;
                floatValue = trijekt.oilTemp;
                isFloat = true;
                unit = " C";
                break;

            // ------------------------------------------------
            // INTAKE PRESSURE
            // ------------------------------------------------

            case M2_INTAKE:
                valid = pressureOK;
                intValue = trijekt.intakePressure;
                unit = " hPa";
                break;

            // ------------------------------------------------
            // EXTERNAL PRESSURE
            // ------------------------------------------------

            case M2_EXTERNAL:
                valid = pressureOK;
                intValue = trijekt.externalPressure;
                unit = " hPa";
                break;

            // ------------------------------------------------
            // FUEL PRESSURE
            // ------------------------------------------------

            case M2_FUEL_PRESSURE:
                valid = pressureOK;
                intValue = trijekt.fuelPressure;
                unit = " kPa";
                break;

            // ------------------------------------------------
            // OIL PRESSURE
            // ------------------------------------------------

            case M2_OIL_PRESSURE:
                valid = pressureOK;
                intValue = trijekt.oilPressure;
                unit = " kPa";
                break;

            // ------------------------------------------------
            // LAMBDA 1
            // ------------------------------------------------

            case M2_LAMBDA1:
                valid = lambda1OK;
                floatValue = trijekt.lambda1;
                isFloat = true;
                decimals = 3;
                break;

            // ------------------------------------------------
            // LAMBDA 2
            // ------------------------------------------------

            case M2_LAMBDA2:
                valid = lambda2OK;
                floatValue = trijekt.lambda2;
                isFloat = true;
                decimals = 3;
                break;

            // ------------------------------------------------
            // BATTERY
            // ------------------------------------------------

            case M2_BATTERY:
                valid = batteryOK;
                floatValue = trijekt.battery;
                isFloat = true;
                decimals = 2;
                unit = " V";
                break;

            // ------------------------------------------------
            // MAX RPM
            // ------------------------------------------------

            case M2_MAX_RPM:
                valid = rpm_max > 0;
                intValue = rpm_max;
                break;

            default:
                break;
        }

        // ====================================================
        // FORMAT VALUE
        // ====================================================

        char text[80];

        if (!valid) {

            snprintf(
                text,
                sizeof(text),
                "%s: ---",
                mode2Layout[i].name
            );
        }
        else if (isFloat) {

            snprintf(
                text,
                sizeof(text),
                "%s: %.*f%s",
                mode2Layout[i].name,
                decimals,
                (double)floatValue,
                unit
            );
        }
        else {

            snprintf(
                text,
                sizeof(text),
                "%s: %lu%s",
                mode2Layout[i].name,
                (unsigned long)intValue,
                unit
            );
        }

        // ====================================================
        // UPDATE LVGL LABEL
        // ====================================================

        lv_label_set_text(
            label,
            text
        );
    }
}

// ============================================================
// SETUP
// ============================================================

void setup()
{
    Serial.begin(115200);

    delay(300);

    Serial.println();
    Serial.println("====================================");
    Serial.println("WAVESHARE TRIJEKT PREMIUM 3.0");
    Serial.println("RWB DASHBOARD");
    Serial.println("MODE 1 / MODE 2");
    Serial.println("HOLLOW22 FONT");
    Serial.println("REAL CAN - NO SIMULATION");
    Serial.println("====================================");

    // ========================================================
    // INITIALIZE ECU DATA
    // ========================================================

    ecu = ECUData{};
    trijekt = TrijektValues{};

    // ========================================================
    // INITIALIZE WAVESHARE DISPLAY
    // ========================================================

    board = new Board();

    board->init();

#if LVGL_PORT_AVOID_TEARING_MODE

    {
        auto lcd = board->getLCD();

        lcd->configFrameBufferNumber(
            LVGL_PORT_DISP_BUFFER_NUM
        );
    }

#endif

    assert(board->begin());

    // ========================================================
    // INITIALIZE LVGL
    // ========================================================

    lvgl_port_init(
        board->getLCD(),
        board->getTouch()
    );

    lvgl_port_lock(-1);

    // Original RWB dashboard
    ui_init();

    // Save MODE 1 screen
    if (objects.label_batt) {

        originalScreen =
            lv_obj_get_screen(objects.label_batt);
    }
    else {

        originalScreen = lv_scr_act();
    }

    // Create MODE 2 screen with Hollow22 font
    createCANScreen();

    // Connect MODE 2 touch button
    bool mode2Found =
        findAndAttachMode2(originalScreen);

    if (!mode2Found) {

        Serial.println(
            "WARNING: MODE 2 BUTTON NOT FOUND"
        );

        Serial.println(
            "Connect open_trijekt_mode2() in screens.c"
        );
    }

    // Start on MODE 1
    if (originalScreen) {
        lv_scr_load(originalScreen);
    }

    lvgl_port_unlock();

    Serial.println("LVGL UI READY");

    // ========================================================
    // INITIALIZE CAN
    // ========================================================

    can_ok = waveshare_twai_init();

    if (can_ok) {

        Serial.println("CAN INITIALIZED");
    }
    else {

        Serial.println("CAN INITIALIZATION FAILED");
    }

    // ========================================================
    // INITIALIZE ESP-NOW
    // ========================================================

    if (espnow_init_simple()) {

        Serial.println("ESP-NOW INITIALIZED");
    }
    else {

        Serial.println("ESP-NOW FAILED");
    }

    Serial.println();
    Serial.println("WAITING FOR TRIJEKT CAN DATA");
    Serial.println();
}

// ============================================================
// MAIN LOOP
// ============================================================

void loop()
{
    uint32_t now = millis();

    // ========================================================
    // 1. READ CAN FRAMES
    // ========================================================

    if (can_ok) {

        twai_message_t msg;

        for (int i = 0; i < CAN_BATCH_SIZE; i++) {

            esp_err_t result = twai_receive(
                &msg,
                0
            );

            if (result != ESP_OK)
                break;

            recordCANFrame(msg);

            decodeCANMessage(msg);
        }
    }

    // ========================================================
    // 2. ECU HOUSEKEEPING
    // ========================================================

    updateECUHousekeeping();

    // ========================================================
    // 3. UPDATE LVGL
    // ========================================================

    static uint32_t lastUI = 0;

    now = millis();

    if (now - lastUI >= UI_INTERVAL_MS) {

        lvgl_port_lock(-1);

        // ====================================================
        // MODE 1 - ORIGINAL RWB DASHBOARD
        // ====================================================

        if (lv_scr_act() == originalScreen) {

            update_mock_rpm();
            update_mock_throttle();
            update_mock_lambda();
            update_mock_motor_temp();
        }

        // ====================================================
        // MODE 2 - HOLLOW22 CAN VALUES
        // ====================================================

        if (lv_scr_act() == canScreen) {

            updateCANScreen();
        }

        lvgl_port_unlock();

        lastUI = millis();
    }

    // ========================================================
    // 4. ESP-NOW
    // ========================================================

    sendEspNowValues();

    // ========================================================
    // 5. SERIAL LIVE VALUES
    // ========================================================

    static uint32_t lastDebug = 0;

    now = millis();

    if (now - lastDebug >= DEBUG_INTERVAL_MS) {

        printAllValues();

        lastDebug = millis();
    }

    // ========================================================
    // 6. CAN DIAGNOSTICS
    // ========================================================

    now = millis();

    if (
        now - canLastReportMs >=
        CAN_DEBUG_INTERVAL_MS
    ) {

        printCANDiagnostics();
    }

    // ========================================================
    // 7. SHORT DELAY
    // ========================================================

    delay(1);
}
